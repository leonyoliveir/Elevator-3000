## CMakeLists.txt
```
cmake_minimum_required(VERSION 3.13.1)

include($ENV{ZEPHYR_BASE}/cmake/app/boilerplate.cmake NO_POLICY_SCOPE)
project(shell_exercise)

list(APPEND HEADERS
    "${PROJECT_BINARY_DIR}/include/generated"
    "${PROJECT_BINARY_DIR}/zephyr/include/generated"
    "${PROJECT_SOURCE_DIR}/include"
)

list(APPEND SOURCES
    "${PROJECT_SOURCE_DIR}/src/main.c"
    "${PROJECT_SOURCE_DIR}/src/L298N.c"
    "${PROJECT_SOURCE_DIR}/src/HCSR04.c"
    "${PROJECT_SOURCE_DIR}/src/button.c"
    "${PROJECT_SOURCE_DIR}/src/led.c"
    "${PROJECT_SOURCE_DIR}/src/calls.c"
    "${PROJECT_SOURCE_DIR}/src/CD4511.c"
    "${PROJECT_SOURCE_DIR}/src/bt.c"
)

include_directories(${HEADERS})
target_sources(app PRIVATE ${SOURCES})
```

## prj.conf
```kconfig
# Enable debug
CONFIG_PRINTK=y
CONFIG_GPIO=y
CONFIG_SHELL=y
CONFIG_DEVICE_SHELL=y
CONFIG_KERNEL_SHELL=y

#########################
#### BLUETOOTH SETUP ####
#########################

CONFIG_BT=y
CONFIG_BT_DEBUG_LOG=y
CONFIG_BT_DEBUG_MONITOR=n
CONFIG_BT_SMP=n
CONFIG_BT_CENTRAL=y
CONFIG_BT_GATT_CLIENT=y
CONFIG_BT_MAX_CONN=3
CONFIG_BT_DEVICE_NAME="ELEVADOR_3000"
CONFIG_BT_PERIPHERAL=y
CONFIG_BT_CONN=y
CONFIG_BT_TINYCRYPT_ECC=y
CONFIG_BT_RX_BUF_COUNT=60
CONFIG_NET_BUF_USER_DATA_SIZE=16
CONFIG_BT_L2CAP_TX_BUF_COUNT=16

CONFIG_BT_RX_BUF_LEN=300
CONFIG_BT_L2CAP_TX_MTU=300
CONFIG_BT_L2CAP_RX_MTU=300
CONFIG_BT_ATT_TX_MAX=6
```

## src/main.c
```c
#include <zephyr.h>
#include <misc/printk.h>
#include <misc/util.h>
#include <sys_clock.h>
#include <shell/shell.h>
#include "define.h"
#include "L298N.h" // Ponte H
#include "HCSR04.h" // Sensor Ultrassônico
#include "button.h" // Botão
#include "led.h" // Led
#include "calls.h" // Chamada
#include "CD4511.h" // Decodificador
#include "bt.h"

l298n_t h_bridge;
hcsr04_t ultrasonic;
cd4511_t decoder;
button_t in_ground, in_first, in_second, in_third, out_ground, out_first, out_second, out_third;
led_t led_up, led_down, led_door;

void in_button_callback(struct device *dev, struct gpio_callback *cb, u32_t pin)
{
    if(pin & 1 << IN_GROUND)
    {
        printk("Ground floor called from inside\n");
        update_calls(INSIDE, GROUND);
    }
    if(pin & 1 << IN_FIRST)
    {
        printk("First floor called from inside\n");
        update_calls(INSIDE, FIRST);
    }
    if(pin & 1 << IN_SECOND)
    {
        printk("Second floor called from inside\n");
        update_calls(INSIDE, SECOND);
    }
    if(pin & 1 << IN_THIRD)
    {
        printk("Third floor called from inside\n");
        update_calls(INSIDE, THIRD);
    }
}

void out_button_callback(struct device *dev, struct gpio_callback *cb, u32_t pin)
{
    if(pin & 1 << OUT_GROUND)
    {
        printk("Ground floor called from outside\n");
        update_calls(OUTSIDE, GROUND);
    }
    if(pin & 1 << OUT_FIRST)
    {
        printk("First floor called from outside\n");
        update_calls(OUTSIDE, FIRST);
    }
    if(pin & 1 << OUT_SECOND)
    {
        printk("Second floor called from outside\n");
        update_calls(OUTSIDE, SECOND);
    }
    if(pin & 1 << OUT_THIRD)
    {
        printk("Third floor called from outside\n");
        update_calls(OUTSIDE, THIRD);
    }
}

void read_ultrasonic(void)
{
    floor_t floor = GROUND;
    while(1)
    {
        int distance = get_distance(&ultrasonic);
        if(distance >= 4 && distance <= 6) floor = GROUND;
        else if(distance >= 24 && distance <= 26) floor = FIRST;
        else if(distance >= 44 && distance <= 46) floor = SECOND;
        else if(distance >= 64 && distance <= 66) floor = THIRD;
        update_level(floor);
        //printk("Distancia atual: %d\n", distance);
    }
}

K_THREAD_DEFINE(read, STACKSIZE, read_ultrasonic, NULL, NULL, NULL, PRIORITY, 0, K_NO_WAIT);

void control_outputs(state_t atual, floor_t atual_level)
{
    printk("Controling outputs...\n");
    decoder_set(&decoder, atual_level);
    switch(atual)
    {
        case GOING_UP:
            turn_left_motor(&h_bridge);
            led_set(&led_up, 0);
            led_set(&led_down, 1);
            led_set(&led_door, 1);
            break;
        case GOING_DOWN:
            turn_right_motor(&h_bridge);
            led_set(&led_up, 1);
            led_set(&led_down, 0);
            led_set(&led_door, 1);
            break;
        case WAITING:
            led_set(&led_up, 1);
            led_set(&led_down, 1);
            led_set(&led_door, 0);
            stop_motor(&h_bridge);
            break;
        default:
            led_set(&led_up, 1);
            led_set(&led_down, 1);
            led_set(&led_door, 1);
            stop_motor(&h_bridge);
            break;
    }
}

// Timeout de 5 segundos
u8_t timeout()
{
    k_sleep(K_SECONDS(5));
    return 1;
}

// Máquina de Estados
void state_machine()
{
    static floor_t atual_level;
    static floor_t next_level;
    static state_t atual = STOPPED;
    static state_t next = STOPPED;
    static state_t previous = STOPPED;
    atual_level = check_level();
    switch(atual)
    {
        case STOPPED:
            printk("Elevator stopped at %d floor...\n", atual_level);
            if(check_calls(atual_level)) next = WAITING;
            else if(check_calls_up(atual_level))
            {
                printk("Call received up...\n");
                next = GOING_UP;
                next_level = atual_level + 1;
            } 
            else if(check_calls_down(atual_level))
            {
                next = GOING_DOWN;
                next_level = atual_level - 1;
            }
            else next = STOPPED;
            break;
        case GOING_UP:
            printk("Elevator rising up from %d floor to %d floor...\n", atual_level, next_level);
            if(atual_level == next_level && check_calls(atual_level))
            {
                next = WAITING;
                previous = GOING_UP;
            }
            else 
            {
                next = GOING_UP;
                next_level = atual_level + 1;
            }
            break;
        case GOING_DOWN:
            printk("Elevator falling down from %d floor to %d floor...\n", atual_level, next_level);
            if(atual_level == next_level && check_calls(atual_level))
            {
                next = WAITING;
                previous = GOING_DOWN;  
            }
            else
            {
                next = GOING_DOWN;
                next_level = atual_level - 1;
            } 
            break;
        case WAITING:
            printk("Elevator waiting for timeout...\n");
            if(timeout())
            {
                calls_t source = ARRIVE;
                update_calls(source, atual_level);
                if(previous == GOING_UP && check_calls_up(atual_level))
                {
                    next = GOING_UP;
                    next_level = next_level + 1;
                } 
                else if(previous == GOING_DOWN && check_calls_down(atual_level))
                {
                    next = GOING_DOWN;
                    next_level = next_level + 1;
                } 
                else next = STOPPED;
            }
            else next = WAITING;
            break;
        default:
            next = STOPPED;
            break;
    }
    atual = next;
    control_outputs(atual, atual_level);
    printk("Andar atual: %d\n", atual_level);
}

void initializing_elevator(void)
{
    new_bridge(&h_bridge, DEVICE, BRIDGE_ENABLE, BRIDGE_PIN1, BRIDGE_PIN2);
    new_ultrasonic(&ultrasonic, DEVICE, US_TRIG_PIN, US_ECHO_PIN);
    new_decoder(&decoder, DEVICE, DECODER_PIN1, DECODER_PIN2);
    new_led(&led_up, DEVICE, LED_UP);
    new_led(&led_down, DEVICE, LED_DOWN);
    new_led(&led_door, DEVICE, LED_DOOR);
    new_button(&out_ground, DEVICE, OUT_GROUND, out_button_callback);
    new_button(&out_first, DEVICE, OUT_FIRST, out_button_callback);
    new_button(&out_second, DEVICE, OUT_SECOND, out_button_callback);
    new_button(&out_third, DEVICE, OUT_THIRD, out_button_callback);
    new_button(&in_ground, DEVICE, IN_GROUND, in_button_callback);
    new_button(&in_first, DEVICE, IN_FIRST, in_button_callback);
    new_button(&in_second, DEVICE, IN_SECOND, in_button_callback);
    new_button(&in_third, DEVICE, IN_THIRD, in_button_callback);
    calls_t calls = INSIDE;
    floor_t floors = GROUND;
    update_calls(calls, floors); 
}

int cmd_test_calls(const struct shell *shell, size_t argc, char **argv)
{
    int floor = *(*(argv + 1));
    shell_print(shell, "Calling elevator on floor %d...\n", floor);
    update_inside(floor, 1);
    shell_print(shell, "Called succesfully!\n");
    return 0;
}

int cmd_test_leds(const struct shell *shell, size_t argc, char **argv)
{
    shell_print(shell, "Testing leds of elevator going up...\n");
    led_set(&led_up, 0);
    k_sleep(SLEEP_TIME);
    led_set(&led_up, 1);
    shell_print(shell, "Testing leds of elevator going down...\n");
    led_set(&led_down, 0);
    k_sleep(SLEEP_TIME);
    led_set(&led_down, 1);
    shell_print(shell, "Test ended!\n");
    return 0;
}

int cmd_test_door(const struct shell *shell, size_t argc, char **argv)
{
    shell_print(shell, "Opening door and waiting for timeout...\n");
    led_set(&led_door, 0);
    if(timeout())
    {
        shell_print(shell, "Timeout reached! Closing door...\n");
        led_set(&led_door, 1);
    }
    shell_print(shell, "Test door ended\n");
    return 0;
}

SHELL_STATIC_SUBCMD_SET_CREATE(sub_test,
    SHELL_CMD_ARG(door, NULL, "Test door", cmd_test_door, 1, NULL),
	SHELL_CMD_ARG(call, NULL, "Call elevator to floor", cmd_test_calls, 2, NULL),
    SHELL_CMD_ARG(led, NULL, "Test the going up and going down leds", cmd_test_leds, 1, NULL),
	SHELL_SUBCMD_SET_END
);

SHELL_CMD_REGISTER(test, &sub_test, "Test comands for elevator 3000", NULL);

// Main
int main(void)
{
    int err;
    
    if( err = bt_init(), err ){
        // LOG_ERR("Bluetooth init error (%d)", err);
        return 0;
    }

    initializing_elevator();
    while(1)
    {
        state_machine();
        k_sleep(K_SECONDS(1));
    }
    return 0;
}
```

## include/CD4511.h
```c
/**
Display de 7 segmentos
**/
#ifndef _CD4511_H_
#define _CD4511_H_

#include <device.h>
#include <gpio.h>

struct cd4511{
    struct device *device;
    char *dev_label;
    u32_t digit_one;
    u32_t digit_two;
    u8_t state_digit_one;
    u8_t state_digit_two;
};

typedef struct cd4511 cd4511_t;

/** 
 * Essa função tem como objetivo iniciar o driver do decoder,
 * ou seja, iniciar o device. 
 * @param decoder 
 *
 * @return 
 */
int decoder_open(cd4511_t *decoder, char *dev_label);

/** 
 * Essa função tem como objetivo configurar o pino do decoder
 * de acordo com suas flags.
 * @param decoder 
 * @param digit_one
 * @param digit_two 
 * @param flags 
 *
 * @return 
 */
int decoder_configure(cd4511_t *decoder, u32_t digit_one, u32_t digit_two, int flags);

/** 
 * Essa função tem como objetivo setar o estado do pino de
 * saída de acordo com o andar setado.
 * @param decoder
 * @param floor
 *
 * @return 
 */
int decoder_set(cd4511_t *decoder, u8_t floor);

/** 
 * Essa função tem como objetivo verificar se o device do
 * decoder foi inicializado apropriadamente.
 * @param decoder
 *
 * @return 
 */
int decoder_check_error(cd4511_t *decoder);

/** 
 * Essa função tem como objetivo criar o novo device de decoder
 * fazendo as chamadas padrão de open e configure
 * @param decoder
 * @param dev_label
 * @param digit_one_pin
 * @param digit_two_pin
 *
 * @return 
 */
int new_decoder(cd4511_t *decoder, char *dev_label, u32_t digit_one_pin, u32_t digit_two_pin);

#endif
```

## include/HCSR04.h
```c
/**
Sensor Ultrassônico
**/

#ifndef _HCRS04_H_
#define _HCRS04_H_

#include <device.h>
#include <gpio.h>

struct hcsr04 {
    struct device *device;
    char *dev_label;
    u32_t pin_echo;
    u32_t pin_trigger;
};

typedef struct hcsr04 hcsr04_t;

/** 
 * Essa função tem como objetivo iniciar o driver hcsr04,
 * ou seja, iniciar o device. 
 * @param ultrasonic
 *
 * @return 
 */
int ultrasonic_open(hcsr04_t *ultrasonic, char *dev_label);

/** 
 * Essa função tem como objetivo configurar o pino de saída
 * de acordo com suas flags.
 * @param ultrasonic
 * @param pin_trigger
 * @param pin_echo
 * @param flags_trigger
 * @param flags_echo
 *
 * @return 
 */
int ultrasonic_configure(hcsr04_t *ultrasonic, u32_t pin_trigger, u32_t pin_echo, int flags_trigger, int flags_echo);

/** 
 * Essa função tem como objetivo verificar a distancia
 * do objeto em relacao ao sensor ultrasonico.
 * @param ultrasonic
 *
 * @return distance
 */
int get_distance(hcsr04_t *ultrasonic);

/** 
 * Essa função tem como objetivo verificar se o device do
 * sensor ultrasonico foi inicilizado apropriadamente.
 * @param ultrasonic
 *
 * @return 
 */
int ultrasonic_check_error(hcsr04_t *ultrasonic);

/** 
 * Essa função tem como objetivo criar o novo device da ponte H
 * fazendo as chamadas padrão de open e configure
 * @param bridge
 * @param dev_label
 * @param enable_pin
 * @param pin_trigger
 * @param pin_echo
 *
 * @return 
 */
int new_ultrasonic(hcsr04_t *ultrasonic, char *dev_label, u32_t pin_trigger, u32_t pin_echo);

#endif
```

## include/L298N.h
```c
/**
Ponte H
**/
#ifndef _L298N_H_
#define _L298N_H_

#include <device.h>
#include <gpio.h>

struct l298n {
    struct device *device;
    char *dev_label;
    u32_t enable_pin;
    u32_t pin_one;
    u32_t pin_two;
    u8_t enable;
    u8_t state_one;
    u8_t state_two;
};

typedef struct l298n l298n_t;

/** 
 * Essa função tem como objetivo iniciar o driver l298n,
 * ou seja, iniciar o device. 
 * @param bridge
 *
 * @return 
 */
int bridge_open(l298n_t *bridge, char *dev_label);

/** 
 * Essa função tem como objetivo configurar os pinos da bridge
 * de acordo com suas flags.
 * @param bridge
 * @param pin1
 * @param pin2
 * @param enable 
 * @param flags 
 *
 * @return 
 */
int bridge_configure(l298n_t *bridge, u32_t pin1, u32_t pin2, u32_t enable_pin, int flags);

/** 
 * Essa função tem como objetivo habilitar o funcionamento
 * do motor.
 * @param bridge 
 *
 * @return 
 */
int bridge_enable(l298n_t *bridge);

/** 
 * Essa função tem como objetivo escrever os valores dos pinos
 * do motor.
 * @param bridge 
 *
 * @return 
 */
int bridge_set(l298n_t *bridge);

/** 
 * Essa função tem como objetivo realizar a parada
 * do motor.
 * @param bridge 
 *
 * @return 
 */
int stop_motor(l298n_t *bridge);

/** 
 * Essa função tem como objetivo acionar o mecanismo de
 * rotação à esquerda do motor
 * @param bridge 
 *
 * @return 
 */
int turn_left_motor(l298n_t *bridge);

/** 
 * Essa função tem como objetivo acionar o mecanismo de
 * rotação à direita do motor
 * @param bridge 
 *
 * @return 
 */
int turn_right_motor(l298n_t *bridge);

/** 
 * Essa função tem como objetivo verificar se o device do
 * motor foi inicilizado apropriadamente.
 * @param bridge
 *
 * @return 
 */
int bridge_check_error(l298n_t *bridge);

/** 
 * Essa função tem como objetivo criar o novo device da ponte H
 * fazendo as chamadas padrão de open e configure
 * @param bridge
 * @param dev_label
 * @param enable_pin
 * @param pin_one
 * @param pin_two
 *
 * @return 
 */
int new_bridge(l298n_t *bridge, char *dev_label, u32_t enable_pin, u32_t pin_one, u32_t pin_two);

#endif
```

## include/bt.h
```c
/** @file
 *  @brief Bluetooth shell functions
 *
 *  This is not to be included by the application.
 */

/*
 * Copyright (c) 2017 Intel Corporation
 *
 * SPDX-License-Identifier: Apache-2.0
 */

#ifndef __BT_H
#define __BT_H

#include <bluetooth/bluetooth.h>
#include <bluetooth/conn.h>
#include <errno.h>
#include <misc/byteorder.h>
#include <misc/printk.h>
#include <misc/util.h>
#include <settings/settings.h>
#include <stddef.h>
#include <stdlib.h>
#include <string.h>
#include <zephyr.h>
#include <zephyr/types.h>

extern struct bt_conn *default_conn;

int str2bt_addr(const char *str, bt_addr_t *addr);
void conn_addr_str(struct bt_conn *conn, char *addr, size_t len);

int bt_init();

#endif /* __BT_H */
```

## include/button.h
```c
/**
Botão
**/
#ifndef _BUTTON_H_
#define _BUTTON_H_

#include <device.h>
#include <gpio.h>

struct button {
    struct device *device;
    struct gpio_callback gpio_callback;
    char *dev_label;
    u32_t pin;
};

typedef struct button button_t;

/** 
 * Essa função tem como objetivo iniciar o device do driver
 * de entrada.
 * @param in 
 *
 * @return 
 */
int button_open(button_t *in, char *dev_label);

/** 
 * Essa função tem como objetivo configurar o pino de entrada.
 *
 * @param in 
 * @param pin 
 * @param flags 
 * @param cb 
 *
 * @return 
 */
int button_configure(button_t *in, u32_t pin, int flags, gpio_callback_handler_t cb);

/** 
 * Essa função tem como objetivo fazer uma leitura do pino
 * de entrada.
 * @param in 
 * @param state 
 *
 * @return 
 */
int button_read(button_t *in, u32_t *state);

/** 
 * Essa função tem como objetivo verificar se o device de
 * entrada foi inicilizado apropriadamente.
 * @param in 
 *
 * @return 
 */
int button_check_error(button_t *in);

/** 
 * Essa função tem como objetivo criar o novo device de entrada
 * fazendo as chamadas padrão de open e configure
 * @param out
 * @param dev_label
 * @param pin
 *
 * @return 
 */
int new_button(button_t *in, char* dev_label, u32_t pin, gpio_callback_handler_t cb);

#endif
```

## include/calls.h
```c
/**
Chamadas
**/
#ifndef _CALLS_H_
#define _CALLS_H_

#include <zephyr.h>

typedef enum {STOPPED, WAITING, GOING_UP, GOING_DOWN} state_t;
typedef enum {INSIDE, OUTSIDE, ARRIVE} calls_t;
typedef enum {GROUND, FIRST, SECOND, THIRD} floor_t;

void update_level(floor_t level);

void update_inside(floor_t destination, u8_t value);

void update_outside(floor_t destination, u8_t value);

floor_t check_level();

u8_t check_inside(floor_t destination);

u8_t check_outside(floor_t destination);

u8_t check_calls(floor_t destination);

u8_t check_calls_up(floor_t atual);

u8_t check_calls_down(floor_t atual);

void update_calls(calls_t source, floor_t destination);

#endif
```

## include/define.h
```c
/**
Pinos
**/
#define DEVICE "GPIO_0"

#define BRIDGE_ENABLE 2
#define BRIDGE_PIN1 24
#define BRIDGE_PIN2 25
#define US_TRIG_PIN 11
#define US_ECHO_PIN 12
#define DECODER_PIN1 3
#define DECODER_PIN2 4
#define IN_GROUND 13
#define IN_FIRST 14
#define IN_SECOND 15
#define IN_THIRD 16
#define OUT_GROUND 17
#define OUT_FIRST 18
#define OUT_SECOND 19
#define OUT_THIRD 20
#define LED_UP 29
#define LED_DOWN 30
#define LED_DOOR 31
#define STACKSIZE 1024
#define PRIORITY 7
#define SLEEP_TIME 500
```

## include/input_ble.h
```c
#include <bluetooth/bluetooth.h>
#include <bluetooth/conn.h>
#include <bluetooth/gatt.h>
#include <bluetooth/hci.h>
#include <bluetooth/uuid.h>
#include <errno.h>
#include <misc/byteorder.h>
#include <misc/printk.h>
#include <settings/settings.h>
#include <stddef.h>
#include <string.h>
#include <zephyr.h>
#include <zephyr/types.h>

int dfu_bt_register(void);

/**
 * @brief 
 * 
 * @return int 
 */
int dfu_bt_unregister(void);
```

## include/led.h
```c
/**
Led
**/

#ifndef _led_H_
#define _led_H_

#include <device.h>
#include <gpio.h>

struct led {
    struct device *device;
    char *dev_label;
    u32_t pin;
    u8_t state;
};

typedef struct led led_t;

/** 
 * Essa função tem como objetivo iniciar o driver led,
 * ou seja, iniciar o device. 
 * @param led
 *
 * @return 
 */
int led_open(led_t *out, char *dev_label);

/** 
 * Essa função tem como objetivo configurar o pino do led
 * de acordo com suas flags.
 * @param out 
 * @param pin 
 * @param flags 
 *
 * @return 
 */
int led_configure(led_t *out, u32_t pin, int flags);

/** 
 * Essa função tem como objetivo setar o estado do pino de
 * saída para algum valor.
 * @param out 
 * @param value 
 *
 * @return 
 */
int led_set(led_t *out, u8_t value);

/** 
 * Essa função tem como objetivo verificar se o device de
 * saída foi inicializado apropriadamente.
 * @param out
 *
 * @return 
 */
int led_check_error(led_t *out);

/** 
 * Essa função tem como objetivo criar o novo device de saída
 * fazendo as chamadas padrão de open e configure
 * @param out
 * @param dev_label
 * @param pin
 *
 * @return 
 */
int new_led(led_t *out, char* dev_label, u32_t pin);
#endif
```

## src/CD4511.c
```c
#include "CD4511.h"
#include <misc/printk.h>

#define ERROR_CODE -1
#define DECODER_FLAGS GPIO_DIR_OUT

int decoder_open(cd4511_t *decoder, char *dev_label)
{
    decoder->device = device_get_binding(dev_label);
    if(decoder_check_error(decoder)) return ERROR_CODE;
    decoder->dev_label = dev_label;
    decoder->digit_one = (u32_t) NULL;
    decoder->digit_two = (u32_t) NULL;
    if(decoder_check_error(decoder)) return ERROR_CODE;
    printk("New decoder initialized succesfullt in the device %s\n", dev_label);
    return 0;
}

int decoder_configure(cd4511_t *decoder, u32_t digit_one, u32_t digit_two, int flags)
{
    if(decoder_check_error(decoder)) return ERROR_CODE;
    decoder->digit_one = digit_one;
    decoder->digit_two = digit_two;
    decoder->state_digit_one = 0;
    decoder->state_digit_two = 0;
    gpio_pin_configure(decoder->device, digit_one, flags);
    gpio_pin_configure(decoder->device, digit_two, flags);
    gpio_pin_write(decoder->device, digit_one, decoder->state_digit_one);
    gpio_pin_write(decoder->device, digit_two, decoder->state_digit_two);
    printk("Decoder configured succesfully at pins %d, %d\n", digit_one, digit_two);
    return 0;
}

int decoder_set(cd4511_t *decoder, u8_t floor)
{
    if(decoder_check_error(decoder)) return ERROR_CODE;
    else if(decoder->digit_one == (u32_t) NULL || decoder->digit_two == (u32_t) NULL)
    {
        printk("ERROR! First configure device\n");
        return ERROR_CODE;
    }
    decoder->state_digit_one = floor & 1;
    decoder->state_digit_two = (floor >> 1) & 1;
    gpio_pin_write(decoder->device, decoder->digit_one, decoder->state_digit_one);
    gpio_pin_write(decoder->device, decoder->digit_two, decoder->state_digit_two);
    printk("Decoder value changed to %d\n", floor);
    return 0;
}

int decoder_check_error(cd4511_t *decoder)
{
    if(!decoder->device)
    {
        printk("ERROR! First initialize device\n");
        return ERROR_CODE;
    }
    return 0;
}

int new_decoder(cd4511_t *decoder, char *dev_label, u32_t digit_one_pin, u32_t digit_two_pin)
{
    printk("Initializing new decoder...\n");
    decoder_open(decoder, dev_label);
    printk("Setting the new decoder...\n");
    decoder_configure(decoder, digit_one_pin, digit_two_pin, DECODER_FLAGS);
    printk("Finished new decoder succesfully!\n");
    return 0;
}
```

## src/HCSR04.c
```c
#include "HCSR04.h"

#define ERROR_CODE -1
#define HIGH 1
#define LOW 0
#define TRIG_FLAGS GPIO_DIR_OUT
#define ECHO_FLAGS GPIO_DIR_IN //| GPIO_INT | GPIO_INT_EDGE | GPIO_INT_ACTIVE_HIGH | GPIO_INT_DEBOUNCE

int ultrasonic_open(hcsr04_t *ultrasonic, char *dev_label)
{
	ultrasonic->device = device_get_binding(dev_label);
	if(ultrasonic_check_error(ultrasonic)) return ERROR_CODE;
	ultrasonic->dev_label = dev_label;
	ultrasonic->pin_echo = (u32_t) NULL;
	ultrasonic->pin_trigger = (u32_t) NULL;
	printk("New Ultrasonic initialized succesfully in the device %s\n", dev_label);
    return 0;
}

int ultrasonic_configure(hcsr04_t *ultrasonic, u32_t pin_trigger, u32_t pin_echo, int flags_trigger, int flags_echo)
{
	if(ultrasonic_check_error(ultrasonic)) return ERROR_CODE;
	ultrasonic->pin_echo = pin_echo;
	ultrasonic->pin_trigger = pin_trigger;
	gpio_pin_configure(ultrasonic->device, pin_echo, flags_echo);
	gpio_pin_configure(ultrasonic->device, pin_trigger, flags_trigger);
	printk("New Ultrasonic configured succesfully in the device %s\n", ultrasonic->dev_label);
	return 0;
}

int ultrasonic_check_error(hcsr04_t *ultrasonic)
{
    if(!ultrasonic->device)
    {
        printk("ERROR! First iniatilize device\n");
        return ERROR_CODE;
    }
    return 0;
}

int get_distance(hcsr04_t *ultrasonic)
{
	if(ultrasonic_check_error(ultrasonic)) return ERROR_CODE;
	else if(ultrasonic->pin_echo == (u32_t) NULL || ultrasonic->pin_trigger == (u32_t) NULL)
	{
		printk("ERROR! First configure device!");
		return ERROR_CODE;
	}
	uint32_t cycles_spent, nanseconds_spent, val, cm, stop_time, start_time;
	gpio_pin_write(ultrasonic->device, ultrasonic->pin_trigger, 0);
	k_sleep(20);
	gpio_pin_write(ultrasonic->device, ultrasonic->pin_trigger, 1);
	k_sleep(12);
	gpio_pin_write(ultrasonic->device, ultrasonic->pin_trigger, 0);
	do {
		gpio_pin_read(ultrasonic->device, ultrasonic->pin_echo, &val);
		//printk("%d\n", val);
	} while (val == 0);
	start_time = k_cycle_get_32();
	do {
		gpio_pin_read(ultrasonic->device, ultrasonic->pin_echo, &val);
		stop_time = k_cycle_get_32();
		cycles_spent = stop_time - start_time;
		if (cycles_spent > 1266720) //260cm for 84MHz (((MAX_RANGE * 58000) / 1000000000) * (CLOCK * 1000000))
		{
			break;
		}
	} while (val == 1);
	nanseconds_spent = SYS_CLOCK_HW_CYCLES_TO_NS(cycles_spent);
	cm = nanseconds_spent / 58000;
	return cm;
}

int new_ultrasonic(hcsr04_t *ultrasonic, char *dev_label, u32_t pin_trigger, u32_t pin_echo)
{
	int error;
    printk("Initializing new Ultrasonic sensor...\n");
    error = ultrasonic_open(ultrasonic, dev_label);
    if(error) return error;
    printk("Setting the new Ultrasonic...\n");
    error = ultrasonic_configure(ultrasonic, pin_trigger, pin_echo, TRIG_FLAGS, ECHO_FLAGS);
    if(error) return error;
    printk("New Ultrasonic initialized succesfully\n");
    return 0;
}
```

## src/L298N.c
```c
#include "L298N.h"

#define ERROR_CODE -1
#define HIGH 1
#define LOW 0
#define L298N_FLAGS GPIO_DIR_OUT

int bridge_open(l298n_t *bridge, char *dev_label)
{
    bridge->device = device_get_binding(dev_label);
    if(bridge_check_error(bridge)) return ERROR_CODE;
    bridge->dev_label = dev_label;
    bridge->enable_pin = (u32_t) NULL;
    bridge->pin_one = (u32_t) NULL;
    bridge->pin_two = (u32_t) NULL;
    bridge->enable = LOW;
    bridge->state_one = LOW;
    bridge->state_two = LOW;
    printk("New H bridge initialized succesfully in the device %s\n", dev_label);
    return 0;
}

int bridge_configure(l298n_t *bridge, u32_t pin1, u32_t pin2, u32_t enable_pin, int flags)
{
    if(bridge_check_error(bridge)) return ERROR_CODE;
    bridge->enable_pin = enable_pin;
    bridge->pin_one = pin1;
    bridge->pin_two = pin2;
    gpio_pin_configure(bridge->device, enable_pin, flags);
    gpio_pin_configure(bridge->device, pin1, flags);
    gpio_pin_configure(bridge->device, pin2, flags);
    gpio_pin_write(bridge->device, bridge->enable_pin, bridge->enable);
    gpio_pin_write(bridge->device, bridge->pin_one, bridge->state_one);
    gpio_pin_write(bridge->device, bridge->pin_two, bridge->state_two);
    printk("New H bridge configured succesfully in the device %s\n", bridge->dev_label);
    return 0;
}

int bridge_enable(l298n_t *bridge)
{
    if(bridge_check_error(bridge)) return ERROR_CODE;
    else if(bridge->enable_pin == (u32_t) NULL)
    {
        printk("ERROR! First configure device\n");
        return ERROR_CODE;
    }
    bridge->enable = HIGH;
    gpio_pin_write(bridge->device, bridge->enable_pin, bridge->enable);
    printk("Bridge enabled succesfully!\n");
    return 0;
}

int bridge_set(l298n_t *bridge)
{
    if(bridge_check_error(bridge)) return ERROR_CODE;
    else if(bridge->pin_one == (u32_t) NULL || bridge->pin_two == (u32_t) NULL)
    {
        printk("ERROR! First configure device\n");
        return ERROR_CODE;
    }
    gpio_pin_write(bridge->device, bridge->pin_one, bridge->state_one);
    gpio_pin_write(bridge->device, bridge->pin_two, bridge->state_two);
    printk("State one: %d\n", bridge->state_one);
    printk("State two: %d\n", bridge->state_two);
    return 0;
}

int stop_motor(l298n_t *bridge)
{
    if(bridge_check_error(bridge)) return ERROR_CODE;
    bridge->state_one = HIGH;
    bridge->state_two = HIGH;
    bridge_set(bridge);
    return 0;
}

int turn_left_motor(l298n_t *bridge) // DESCIDA DO MOTOR
{
    if(bridge_check_error(bridge)) return ERROR_CODE;
    bridge->state_one = LOW;
    bridge->state_two = HIGH;
    bridge_set(bridge);
    return 0;
}

int turn_right_motor(l298n_t *bridge) // SUBIDA DO MOTOR
{
    if(bridge_check_error(bridge)) return ERROR_CODE;
    bridge->state_one = HIGH;
    bridge->state_two = LOW;
    bridge_set(bridge);
    return 0;
}

int bridge_check_error(l298n_t *bridge)
{
    if(!bridge->device)
    {
        printk("ERROR! First iniatilize device\n");
        return ERROR_CODE;
    }
    return 0;
}

int new_bridge(l298n_t *bridge, char *dev_label, u32_t enable_pin, u32_t pin_one, u32_t pin_two)
{
    int error;
    printk("Initializing new H bridge...\n");
    error = bridge_open(bridge, dev_label);
    if(error) return error;
    printk("Setting the new H bridge...\n");
    error = bridge_configure(bridge, pin_one, pin_two, enable_pin, L298N_FLAGS);
    if(error) return error;
    printk("Enabling the new H bridge...\n");
    error = bridge_enable(bridge);
    if(error) return error;
    printk("New H bridge initialized succesfully\n");
    return 0;
}
```
